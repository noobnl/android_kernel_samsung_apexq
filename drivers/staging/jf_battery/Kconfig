## drivers/staging/jf_battery/Kconfig
```kconfig
config JF_BATTERY_SAMSUNG
	tristate "samsung battery driver"
	help
	 Say Y to include support for samsung battery driver
	 This battery driver integrated all battery-related functions
	 To see battery-related functions,
	 refer to sec_charging_common.h

config JF_FUELGAUGE_MAX17048
	tristate "MAX17048 fuel gauge driver"
	default n
	depends on JF_BATTERY_SAMSUNG
	help
	 Say Y to include support
	 for MAXIM MAX17048 fuel gauge driver.
	 This fuel-gauge can be used
	 only in voltage-tracking mode.

config JF_CHARGER_BQ24157
	tristate "BQ24157 charger driver"
	default n
	depends on JF_BATTERY_SAMSUNG
	help
	 Say Y to include support
	 for TI BQ24157 charger driver.
	 This driver source code implemented
	 all functions for BQ24157 charger.
```
